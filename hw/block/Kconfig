## hw/block/Kconfig
```kconfig
config FDC
    bool

config FDC_ISA
    bool
    depends on ISA_BUS
    select FDC

config FDC_SYSBUS
    bool
    select FDC

config SSI_M25P80
    bool

config NAND
    bool

config PFLASH_CFI01
    bool

config PFLASH_CFI02
    bool

config VIRTIO_BLK
    bool
    default y
    depends on VIRTIO

config VHOST_USER_BLK
    bool
    # Only PCI devices are provided for now
    default y if VIRTIO_PCI
    depends on VIRTIO && VHOST_USER && LINUX

config SWIM
    bool

config APPLE_ANS
    bool
    depends on NVME_PCI
    depends on APPLE_SOC

config APPLE_NVME_MMU
    bool
    depends on NVME_PCI
    depends on APPLE_SOC
```
